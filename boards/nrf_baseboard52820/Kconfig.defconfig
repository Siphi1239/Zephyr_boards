## boards/nrf_baseboard52820/Kconfig.defconfig
```kconfig
# BOARD_NRF_BASEBOARD_52820 configuration

# Copyright (c) 2024 siphi1239
# SPDX-License-Identifier: Apache-2.0

if BOARD_NRF_BASEBOARD_52820

config BT_CTLR
	default BT

endif # BOARD_NRF_BASEBOARD_52820
```

## boards/nrf_baseboard52820/Kconfig.nrf_baseboard_52820
```kconfig
# BOARD_NRF_BASEBOARD_52820 configuration

# Copyright (c) 2024 siphi1239
# SPDX-License-Identifier: Apache-2.0

config BOARD_NRF_BASEBOARD_52820
	select SOC_NRF52820_QDAA
```

## boards/nrf_baseboard52820/board.yml
```yaml
board:
  name: nrf_baseboard_52820
  full_name: NRF52820 Baseboard
  vendor: siphi1239
  socs:
  - name: nrf52820
```
